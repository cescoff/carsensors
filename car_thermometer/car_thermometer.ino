#include <Adafruit_GFX.h>
#include <Adafruit_SPITFT.h>
#include <Adafruit_SPITFT_Macros.h>
#include <gfxfont.h>

#include <Adafruit_SSD1306.h>
#include <splash.h>

#include <OneWire.h>
#include <DallasTemperature.h>
#include <Wire.h> 
#include <LiquidCrystal_I2C.h>
#include <Wire.h>


// OLED display TWI address
#define OLED_ADDR   0x3C
#define SSD1306_128_64

// reset pin not used on 4-pin OLED module
Adafruit_SSD1306 display(-1);  // -1 = no reset pin

// 128 x 64 pixel display
#if (SSD1306_LCDHEIGHT != 32)
#error("Height incorrect, please fix Adafruit_SSD1306.h!");
#endif
#define ONE_WIRE_BUS_EXT 5
#define ONE_WIRE_BUS_MOT 5

static const unsigned char PROGMEM cloud_logo[] =
{ 0x00, 0x00, 0x00, 0x00, 0x06, 0x00, 0x1f, 0x80, 0x3f, 0xf0, 0x3f, 0xf8, 0x7f, 0xfc, 0x7f, 0xfe, 
  0xff, 0xff, 0xff, 0xff, 0xff, 0xff, 0x7f, 0xfe, 0x3f, 0xfc, 0x09, 0x24, 0x12, 0x48, 0x24, 0x90 };

// 'Lion_Peugeot_1980', 64x32px
const unsigned char Peugeot_Logo [] PROGMEM = {
  0x00, 0x00, 0x00, 0x00, 0x01, 0x00, 0x00, 0x00, 0x00, 0x00, 0x00, 0x00, 0x7e, 0xe0, 0x00, 0x00, 
  0x00, 0x00, 0x00, 0x07, 0x80, 0x30, 0x00, 0x00, 0x00, 0x0f, 0x00, 0x38, 0x00, 0x18, 0x00, 0x00, 
  0x00, 0x38, 0x60, 0x30, 0x00, 0x0d, 0xf0, 0x00, 0x00, 0x38, 0x38, 0x1f, 0xe0, 0x0f, 0x70, 0x00, 
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  0x00, 0x00, 0x00, 0x00, 0x00, 0x7f, 0xf0, 0x00, 0x00, 0x00, 0x00, 0x00, 0x00, 0x08, 0x00, 0x00
};

// 'Logo_305', 64x20px
const unsigned char logo_305 [] PROGMEM = {
  0x00, 0x00, 0x00, 0x00, 0x00, 0x00, 0x00, 0x00, 0x00, 0x00, 0x00, 0x00, 0x00, 0x00, 0x00, 0x00, 
  0x00, 0x00, 0x00, 0x00, 0x00, 0x00, 0x00, 0x00, 0x00, 0x00, 0x00, 0x00, 0x00, 0x00, 0x00, 0x00, 
  0x00, 0x00, 0x00, 0x00, 0x00, 0x00, 0x00, 0x00, 0x00, 0x00, 0x00, 0x00, 0x00, 0x00, 0x00, 0x00, 
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  0x00, 0x00, 0x00, 0x00, 0x00, 0x00, 0x00, 0x00, 0x00, 0x00, 0x00, 0x00, 0x00, 0x00, 0x00, 0x00
};


// 'SnowFlake', 64x32px
static const unsigned char Snowflake [] PROGMEM = {
  0x00, 0x00, 0x00, 0x00, 0x00, 0x00, 0x00, 0x00, 0x00, 0x00, 0x00, 0x00, 0x00, 0x00, 0x00, 0x00, 
  0x00, 0x00, 0x00, 0x00, 0x00, 0x00, 0x00, 0x00, 0x00, 0x00, 0x00, 0x07, 0xe0, 0x00, 0x00, 0x00, 
  0x00, 0x00, 0x00, 0x07, 0xe0, 0x00, 0x00, 0x00, 0x00, 0x00, 0x00, 0xf7, 0xef, 0x00, 0x00, 0x00, 
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  0x00, 0x00, 0x00, 0x00, 0x00, 0x00, 0x00, 0x00, 0x00, 0x00, 0x00, 0x00, 0x00, 0x00, 0x00, 0x00
};

// 'Engine', 100x32px
static const unsigned char Engine [] PROGMEM = {
 0x00, 0x00, 0x00, 0x0f, 0xff, 0xff, 0xff, 0xe0, 0x00, 0x00, 0x00, 0x00, 0x00, 0x00, 0x00, 0x00, 
  0x1f, 0xff, 0xff, 0xff, 0xe0, 0x00, 0x00, 0x00, 0x00, 0x00, 0x00, 0x00, 0x00, 0x1f, 0xff, 0xff, 
  0xff, 0xe0, 0x00, 0x00, 0x00, 0x00, 0x00, 0x00, 0x00, 0x00, 0x00, 0x1f, 0xff, 0xe0, 0x00, 0x00, 
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  0x00, 0x00, 0x00, 0x00, 0x00, 0x00, 0x00, 0x0f, 0xff, 0xff, 0xff, 0xff, 0xc0, 0x00, 0x00, 0x00
};

// 'Mountain', 32x16px
static const unsigned char Mountain [] PROGMEM = {
  0x00, 0x00, 0x00, 0x00, 0x00, 0x00, 0x00, 0x00, 0x00, 0x00, 0x80, 0x00, 0x00, 0x01, 0xc0, 0x00, 
  0x00, 0x03, 0x60, 0x00, 0x00, 0x06, 0x30, 0x00, 0x00, 0x6c, 0x18, 0x00, 0x00, 0xbf, 0xfc, 0x00, 
  0x01, 0x00, 0x07, 0x80, 0x02, 0x00, 0x03, 0x40, 0x04, 0x00, 0x00, 0x20, 0x08, 0x00, 0x00, 0x10, 
  0x10, 0x00, 0x00, 0x08, 0x3f, 0xff, 0xff, 0xfc, 0x00, 0x00, 0x00, 0x00, 0x00, 0x00, 0x00, 0x00
};

// 'Mountain_Large', 64x32px
static const unsigned char Mountain_Large [] PROGMEM = {
  0x00, 0x00, 0x00, 0x00, 0x00, 0x00, 0x00, 0x00, 0x00, 0x00, 0x00, 0x00, 0x00, 0x00, 0x00, 0x00, 
  0x00, 0x00, 0x00, 0x00, 0x00, 0x00, 0x00, 0x00, 0x00, 0x00, 0x00, 0x00, 0x00, 0x00, 0x00, 0x00, 
  0x00, 0x00, 0x00, 0x00, 0x00, 0x00, 0x00, 0x00, 0x00, 0x00, 0x00, 0x00, 0xc0, 0x00, 0x00, 0x00, 
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  0x00, 0x00, 0x00, 0x00, 0x00, 0x00, 0x00, 0x00, 0x00, 0x00, 0x00, 0x00, 0x00, 0x00, 0x00, 0x00
};

// 'Engine_Medium', 58x18px
const unsigned char Engine_Medium [] PROGMEM = {
  0x00, 0x00, 0xff, 0xff, 0xc0, 0x00, 0x00, 0x00, 0x00, 0x00, 0xff, 0xff, 0xc0, 0x00, 0x00, 0x00, 
  0x00, 0x07, 0xff, 0xff, 0xfe, 0x00, 0x00, 0x00, 0x00, 0x0f, 0xff, 0xff, 0xff, 0x80, 0x00, 0x00, 
  0xe3, 0xfc, 0x00, 0x00, 0x03, 0x80, 0x00, 0x00, 0xe7, 0x80, 0x00, 0x00, 0x03, 0xfd, 0xff, 0x00, 
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  0x00, 0x00, 0x3f, 0xff, 0xff, 0xf9, 0xfe, 0x00, 0x00, 0x00, 0x07, 0xff, 0xff, 0xe0, 0x00, 0x00
};


OneWire oneWire1(ONE_WIRE_BUS_EXT);
OneWire oneWire2(ONE_WIRE_BUS_MOT);

DallasTemperature extSensors(&oneWire1);
DallasTemperature motSensors(&oneWire2);

 float ExtCelcius=0;
 float MotCelcius=0;
 unsigned long lastIceAlertTime=0;
 
 const unsigned long alertThreshold=1*60000;
 const float iceAlertValueThreshold = 4;
 const float motAlertValueThreshold = 95;

void setup(void)
{
  
  Serial.begin(9600);
  extSensors.begin();
  motSensors.begin();

  display.begin(SSD1306_SWITCHCAPVCC, OLED_ADDR);
  display.clearDisplay();
  display.drawBitmap(32, 0, Peugeot_Logo, 64, 32, WHITE);
  display.display();
  delay(20000);
  display.clearDisplay();
}

void loop(void)
{ 
  extSensors.requestTemperatures(); 
  ExtCelcius=extSensors.getTempCByIndex(0);
  motSensors.requestTemperatures(); 
  MotCelcius=motSensors.getTempCByIndex(0);
  Serial.print(" C  ");
  Serial.println(ExtCelcius);

  if (MotCelcius < motAlertValueThreshold) {
    if (ExtCelcius <= iceAlertValueThreshold) {
      unsigned long currentTime=millis();
      unsigned long lastAlertDelta = currentTime - lastIceAlertTime;
      Serial.print("Current Time: ");
      Serial.println(currentTime);
      Serial.print("Last Ice Alert Time: ");
      Serial.println(lastIceAlertTime);
      Serial.print("Last Ice Alert Delta: ");
      Serial.print(lastAlertDelta);
      Serial.print(" <-> ");
      Serial.println(alertThreshold);
      if (lastIceAlertTime == 0 || lastAlertDelta > alertThreshold) {
        displayIceAlert(10, ExtCelcius);
        lastIceAlertTime=millis();
      }
    }
    displayExtAndMot(ExtCelcius, MotCelcius);

    delay(1000);
  } else {
    displayMotAlert(5, MotCelcius);
  }
  
}

void displayExtAndMot(float extCel, float motCel) {
/*  display.clearDisplay();


  display.setTextSize(2);
  display.setTextColor(WHITE);
  display.setCursor(0,0);
  display.print("Ext: ");
  display.println(printFloat(extCel));
  

  display.print("Mot: ");
  display.print(printFloat(motCel));

  display.display();
*/
  display.clearDisplay();
//  display.drawBitmap(0, 0, Mountain_Large, 64, 32, WHITE);
  display.drawBitmap(0, 7, Engine_Medium, 58, 18, WHITE);
  
  display.setTextSize(4);
  display.setTextColor(WHITE);
  if (extCel >= 10) {
    display.setCursor(72,0);
  } else if (extCel >= 0 && extCel < 10) {
    display.setCursor(80,0);
  } else if (extCel < 0 && extCel > -10) {
    display.setCursor(72,0); 
  } else if (extCel <= -10) {
    display.setCursor(68,0); 
  }
  display.println(printFloat(extCel));
  
/*  display.drawBitmap(0, 16, Mountain, 32, 16, WHITE);
  
  display.setTextSize(2);
  display.setTextColor(WHITE);
  display.setCursor(36,16);
  display.print(printFloat(motCel));*/

  display.display();
}

void displayIceAlert(int repeat, float extCel) {
  for (int index = 0; index < repeat; index++) {
    display.clearDisplay();
    display.drawBitmap(32, 0, Snowflake, 64, 32, WHITE);
    display.display();
    delay(2000);
    display.clearDisplay();
    display.setTextSize(4);
    display.setTextColor(WHITE);
    display.setCursor(0,0);
    display.print(printFloat(extCel));
    display.display();
    delay(1000);
    display.clearDisplay();
  }
}

void displayMotAlert(int repeat, float motCel) {
  for (int index = 0; index < repeat; index++) {
    display.clearDisplay();
    display.drawBitmap(14, 0, Engine, 100, 32, WHITE);
    display.display();
    delay(2000);
    display.clearDisplay();
    display.setTextSize(4);
    display.setTextColor(WHITE);
    display.setCursor(0,0);
    display.print(printFloat(motCel));
    display.display();
    delay(1000);
    display.clearDisplay();
  }
}


String printFloat(float floatvalue) {
/*  char str[4];
  dtostrf(floatvalue, 3, 1, str );
  return str;*/
  int intValue = (int) floatvalue;
  float delta = floatvalue - intValue;
  if (delta > 0.5) {
    intValue++;
  }
  return String(intValue);
}
